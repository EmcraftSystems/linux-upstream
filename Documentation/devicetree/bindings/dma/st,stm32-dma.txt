## Documentation/devicetree/bindings/dma/st,stm32-dma.txt
```
* StMicro STM32 Direct Memory Access Controller (DMA)

Required properties:
- compatible: Should be "st,<chip>-dma".
- reg: Should contain DMA registers location and length.
- interrupts: Should contain DMA interrupt.
- #dma-cells: Must be <2>, used to represent the number of integer cells in
the dmas property of client devices.

Example:

dma2: dma@40026400 {
	compatible = "st,stm32f4-dma";
	#dma-cells = <2>;
	reg = <0x40026400 0x400>;
	interrupts = <56 57 58 59 60 68 69 70>;
	clocks = <&rcc 0 22>;
};

DMA clients connected to the STM32 DMA controller must use the format
described in the dma.txt file, using a three-cell specifier for each channel:
a phandle plus two integer cells, which specify the peripheral.
The three cells in order are:

1. A phandle pointing to the DMA controller.
2. The DMA stream
3. The DMA channel

Example:

usart1: serial@40011000 {
	compatible = "st,stm32-usart";
	reg = <0x40011000 0x400>;
	interrupts = <37>;
	st,use-dma-rx;
	st,use-dma-tx;
	dmas = <&dma2 5 4>, <&dma2 7 4>;
	dma-names = "rx", "tx";
};
```

## Documentation/devicetree/bindings/iio/adc/st,stm32-adc.txt
```
STMicroelectronics STM32 ADC device driver

STM32 ADC is a successive approximation analog-to-digital converter.
It has several multiplexed input channels. Conversions can be performed
in single, continuous, scan or discontinuous mode. Result of the ADC is
stored in a left-aligned or right-aligned 32-bit data register.
Conversions can be launched in software or using hardware triggers.

The analog watchdog feature allows the application to detect if the input
voltage goes beyond the user-defined, higher or lower thresholds.

Each STM32 ADC block can have up to 3 ADC instances.

Each instance supports two contexts to manage conversions, each one has its
own configurable sequence and trigger:
- regular conversion can be done in sequence, running in background
- injected conversions have higher priority, and so have the ability to
  interrupt regular conversion sequence (either triggered in SW or HW).
  Regular sequence is resumed, in case it has been interrupted.

Required properties:
- compatible: Should be "st,stm32f4-adc".
- reg: Offset and length of the ADC block register set.
- interrupts: Must contain the interrupt for ADC.
- clocks: Clock for the analog circuitry (common to all ADCs).
- clock-names: Must be "adc".
- vref-supply: Phandle to the vref input analog reference voltage.
- #address-cells = <1>;
- #size-cells = <0>;

Optional properties:
- A pinctrl state named "default" for each ADC channel may be defined to set
  inX ADC pins in mode of operation for analog input on external pin.
- gpios: Array of gpios that may be configured as EXTi trigger sources.

Example:
	adc: adc@40012000 {
		compatible = "st,stm32f4-adc";
		reg = <0x40012000 0x400>;
		interrupts = <18>;
		clocks = <&rcc 0 168>;
		clock-names = "adc";
		vref-supply = <&reg_vref>;
		pinctrl-names = "default";
		pinctrl-0 = <&adc3_in8_pin>;
		gpios = <&gpioa 11 0>,
			<&gpioa 15 0>;

		#address-cells = <1>;
		#size-cells = <0>;

		adc1: adc1-master@0 {
			#io-channel-cells = <1>;
			reg = <0x0>;
			clocks = <&rcc 0 168>;
			st,adc-channels = <8>;
		};
		...
		other adc child nodes follow...
	};

Contents of a stm32 adc child node:
-----------------------------------
An ADC block node should contain at least one subnode, representing an
ADC instance available on the machine.

Required properties:
- reg: Offset of ADC instance in ADC block (e.g. may be 0x0, 0x100, 0x200).
- st,adc-channels: List of single-ended channels muxed for this ADC.
- #io-channel-cells = <1>: See the IIO bindings section "IIO consumers" in
  Documentation/devicetree/bindings/iio/iio-bindings.txt

Optional properties:
- clocks: Input clock private to this ADC instance.
- st,injected: Use injected conversion sequence on an ADC, rather than regular.
- dmas: Phandle to dma channel for this ADC instance, only for regular
  conversions. See ../../dma/dma.txt for details.
- dma-names: Must be "rx" when dmas property is being used.
```

## Documentation/devicetree/bindings/mfd/rohm,bd71837-pmic.txt
```
* ROHM BD71837 and BD71847 Power Management Integrated Circuit bindings

BD71837MWV and BD71847MWV are programmable Power Management ICs for powering
single-core, dual-core, and quad-core SoCs such as NXP-i.MX 8M. They are
optimized for low BOM cost and compact solution footprint. BD71837MWV
integrates 8 Buck regulators and 7 LDOs. BD71847MWV contains 6 Buck regulators
and 6 LDOs.

Datasheet for BD71837 is available at:
https://www.rohm.com/datasheet/BD71837MWV/bd71837mwv-e

Required properties:
 - compatible		: Should be "rohm,bd71837" for bd71837
				    "rohm,bd71847" for bd71847.
 - reg			: I2C slave address.
 - interrupt-parent	: Phandle to the parent interrupt controller.
 - interrupts		: The interrupt line the device is connected to.
 - clocks		: The parent clock connected to PMIC. If this is missing
			  32768 KHz clock is assumed.
 - #clock-cells		: Should be 0.
 - regulators:		: List of child nodes that specify the regulators.
			  Please see ../regulator/rohm,bd71837-regulator.txt

Optional properties:
 - clock-output-names		: Should contain name for output clock.
 - rohm,pmic-buck1-dvs-voltage	: Should contain list of voltage levels matching
				  HW states. First voltage is for RUN, second
				  for IDLE and third for SUSPEND. Voltages
				  should be given in uV.
 - rohm,pmic-buck2-dvs-voltage	: Like rohm,pmic-buck1-dvs-voltage but SUSPEND
				  state is not used. Only give voltages for RUN
				  and IDLE
 - rohm,pmic-buck3-dvs-voltage	: Like rohm,pmic-buck2-dvs-voltage but only for
				  RUN state. Not on BD71847.
 - rohm,pmic-buck4-dvs-voltage	: Like rohm,pmic-buck3-dvs-voltage.
				  Not on BD71847.


Example:

	/* external oscillator node */
	osc: oscillator {
		compatible = "fixed-clock";
		#clock-cells = <1>;
		clock-frequency  = <32768>;
		clock-output-names = "osc";
	};

	pmic: pmic@4b {
		compatible = "rohm,bd71837";
		reg = <0x4b>;
		interrupt-parent = <&gpio1>;
		interrupts = <29 GPIO_ACTIVE_LOW>;
		interrupt-names = "irq";
		#clock-cells = <0>;
		clocks = <&osc 0>;
		clock-output-names = "bd71837-32k-out";

		rohm,pmic-buck1-dvs-voltage = <900000>, <850000>, <800000>;
		rohm,pmic-buck2-dvs-voltage = <1000000>, <900000>;
		rohm,pmic-buck3-dvs-voltage = <900000>;
		rohm,pmic-buck4-dvs-voltage = <900000>;
		regulators {
			buck1: BUCK1 {
				regulator-name = "buck1";
				regulator-min-microvolt = <700000>;
				regulator-max-microvolt = <1300000>;
				regulator-boot-on;
				regulator-ramp-delay = <1250>;
			};
		};
	};

	/* Clock consumer node */
	rtc@0 {
		compatible = "company,my-rtc";
		clock-names = "my-clock";
		clocks = <&pmic>;
	};
```

## Documentation/devicetree/bindings/net/st,stm32f4-dwmac.txt
```
* STmicro STM32F2xx, STM32F4xx, STM32F7xx ethernet controller

This device is a platform glue layer for stmmac.
Please see stmmac.txt for the other unchanged properties.

Required properties:
 - compatible:  Should contain "st,stm32-dwmac"

Examples:

mac: ethernet@40010000 {
	compatible = "stm,stm32-dwmac", "snps,dwmac-3.611", "snps,dwmac";
	reg = <0x40028000 0x2000>;
	interrupts = <61>;
	interrupt-names = "macirq";
	clocks = <&rcc 0 25>, <&rcc 0 26>, <&rcc 0 27>;
	clock-names = "stmmaceth", "stm32_mac_tx", "stm32_mac_rx";
}
```

## Documentation/devicetree/bindings/pinctrl/pinctrl-stm32.txt
```
* STM32 GPIO and Pin Mux/Config controller

STMicroelectronics's STM32 MCUs intregrate a GPIO and Pin mux/config hardware
controller. It controls the input/output settings on the available pins and
also provides ability to multiplex and configure the output of various on-chip
controllers onto these pads.

Pin controller node:
Required properies:
- compatible	: "st,stm32-pinctrl"
- #address-cells: The value of this property must be 1
- #size-cells	: The value of this property must be 1
- ranges	: defines mapping between pin controller node (parent) to
  gpio-bank node (children).

GPIO controller/bank node:
Required properties:
- gpio-controller : Indicates this device is a GPIO controller
- #gpio-cells	  : Should be two.
			The first cell is the pin number
			The second one is the polarity:
				- 0 for active high
				- 1 for active low
- reg		  : The gpio address range, relative to the pinctrl range
- st,bank-name	  : Should be a name string for this bank as specified in
  the datasheet

Optional properties:
- reset:	  : Reference to the reset controller

Example:
#include <dt-bindings/pinctrl/pinctrl-stm32.h>
...

	pin-controller {
		#address-cells = <1>;
		#size-cells = <1>;
		compatible = "st,stm32-pinctrl";
		ranges = <0 0x40020000 0x3000>;

		gpioa: gpio@40020000 {
			gpio-controller;
			#gpio-cells = <2>;
			reg = <0x0 0x400>;
			resets = <&reset_ahb1 0>;
			st,bank-name = "GPIOA";
		};
		...
		pin-functions nodes follow...
	};

Contents of function subnode node:
----------------------------------

Required properties for pin configuration node:
- st,pins	: Child node with list of pins with configuration.

Below is the format of how each pin conf should look like.

<bank offset altmode pull type speed>

Every PIO is represented with 4 to 6 parameters.
Each parameter is explained as below.

- bank	  : Should be bank phandle to which this PIO belongs.
- offset  : Offset in the PIO bank.
- altmode : Should be mode or alternate function number associated this pin, as
described in the datasheet (IN, OUT, ALT0...ALT15, ANALOG)
- pull	  : Should be either NO_PULL, PULL_UP or PULL_DOWN
- type	  : Should be either PUSH_PULL or OPEN_DRAIN.
	    Setting it is not needed for IN and ANALOG modes, or alternate
	    functions acting as inputs.
- speed	  : Value taken from the datasheet, depending on the function
(LOW_SPEED, MEDIUM_SPEED, FAST_SPEED, HIGH_SPEED)
	    Setting it is not needed for IN and ANALOG modes, or alternate
	    functions acting as inputs.

usart1 {
	pinctrl_usart1: usart1-0 {
		st,pins {
			tx = <&gpioa 9 ALT7 NO_PULL PUSH_PULL LOW_SPEED>;
			rx = <&gpioa 10 ALT7 NO_PULL PUSH_PULL LOW_SPEED>;
		};
	};
};

adc2 {
	pinctrl_adc2: adc2-0 {
		st,pins {
			adc0 = <&gpioe 4 ANALOG NO_PULL>;
		};
	};
};

usart1: usart@40011000 {
	...
	pinctrl-names = "default";
	pinctrl-0 = <&pinctrl_usart1>;
};
```

## Documentation/devicetree/bindings/reset/st,stm32-rcc.txt
```
STMicroelectronics STM32 Peripheral Reset Controller
====================================================

The RCC IP is both a reset and a clock controller. This documentation only
documents the reset part.

Please also refer to reset.txt in this directory for common reset
controller binding usage.

Required properties:
- compatible: Should be "st,stm32-rcc"
- reg: should be register base and length as documented in the
  datasheet
- #reset-cells: 1, see below

example:

rcc: reset@40023800 {
	#reset-cells = <1>;
	compatible = "st,stm32-rcc";
	reg = <0x40023800 0x400>;
};

Specifying softreset control of devices
=======================================

Device nodes should specify the reset channel required in their "resets"
property, containing a phandle to the reset device node and an index specifying
which channel to use.
The index is the bit number within the RCC registers bank, starting from RCC
base address.
It is calculated as: index = register_offset / 4 * 32 + bit_offset.
Where bit_offset is the bit offset within the register.
For example, for CRC reset:
  crc = AHB1RSTR_offset / 4 * 32 + CRCRST_bit_offset = 0x10 / 4 * 32 + 12 = 140

To simplify the usagen and to share bit definition with the clock driver of
the RCC IP, macros are available to generate the index in human-readble
format.

For STM32F4 series, the macro are available here:
 - include/dt-bindings/mfd/stm32f4-rcc.h

example:

	timer2 {
		resets			= <&rcc STM32F4_APB1_RESET(TIM2)>;
	};
```

## arch/arm/mach-kinetis/Kconfig
```kconfig
if ARCH_KINETIS

config SOC_K70
	bool
	depends on ARCH_KINETIS
	select PINCTRL_KINETIS

config MACH_KINETIS
	bool "Kinetis K70 based development board"
	default y
	select SOC_K70
	help
	  Say Y here if you are using Kinetis K70 based development board

endif
```

## drivers/iio/adc/stm32/Kconfig
```kconfig
#
# STM32 familly ADC drivers
#

config STM32_ADC
	tristate
	select REGULATOR
	select REGULATOR_FIXED_VOLTAGE
	select IIO_BUFFER
	select IIO_TRIGGERED_BUFFER
	select IRQ_WORK
	help
	  Say yes here to build the driver for the STMicroelectronics
	  STM32 analog-to-digital converter (ADC).

	  This driver can also be built as a module.  If so, the module
	  will be called stm32-adc.

config STM32F4_ADC
	tristate "STMicroelectronics STM32F4 adc"
	depends on ARCH_STM32 || COMPILE_TEST
	depends on HAS_DMA
	depends on OF
	select STM32_ADC
	help
	  Say yes here to build support for STMicroelectronics stm32f4 Analog
	  to Digital Converter (ADC).

	  This driver can also be built as a module.  If so, the module
	  will be called stm32f4-adc.

config STM32_ADC_DEBUG
	bool "Enable debug for stm32 ADC drivers"
	depends on STM32_ADC
	help
	  Say "yes" to enable debug messages, on stm32 ADC drivers.
```

## sound/soc/stm/Kconfig
```kconfig
menu "SoC Audio for STM32 CPUs"

comment "Common SoC Audio options for STM32 CPUs:"

config SND_SOC_STM32_SAI
	tristate "SoC Audio support for the STM32 SAI module"
	depends on ARCH_STM32
	select SND_SOC_GENERIC_DMAENGINE_PCM
	help
	  Say Y or M if you want to add support for codecs attached to
	  the STM32 SAI interface.

config SND_SOC_STM32_ASOC_CARD
	tristate "Generic ASoC Sound Card"
	depends on OF && I2C
	select SND_SOC_STM32_SAI
	help
	  ALSA SoC Audio support for STMicro SoCs that have SAI and connect
	  with external CODECs such as NAU8822.
	  Say Y if you want to add support for STM32 Generic ASoC Sound Card.

endmenu
```
